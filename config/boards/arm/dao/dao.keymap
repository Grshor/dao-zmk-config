/*
 * Copyright (c) 2021 Rafael Yumagulov
 *
 * SPDX-License-Identifier: MIT
 */

#include <behaviors.dtsi>
#include <dt-bindings/zmk/keys.h>
#include <dt-bindings/zmk/bt.h>

#define DEF 0
#define LWR 1
#define FNL 2
#define ADJ 3

&lt { quick_tap_ms = <130>; };
&mt { quick_tap_ms = <130>; };

&caps_word {
    continue-list = <UNDERSCORE MINUS>;
};

/ {
        behaviors {
                hm: homerow_mods {
                        compatible = "zmk,behavior-hold-tap";
                        label = "HOMEROW_MODS";
                        #binding-cells = <2>;
                        tapping-term-ms = <150>;
                        quick-tap-ms = <200>;
                        flavor = "tap-preferred";
                        bindings = <&kp>, <&kp>;
                };
                shfm: shift_mod {
                        compatible = "zmk,behavior-hold-tap";
                        label = "SHIFT_MOD";
                        #binding-cells = <2>;
                        tapping-term-ms = <150>;
                        quick-tap-ms = <200>;
                        flavor = "tap-preferred";
                        bindings = <&kp>, <&kp>;
                        // mods = <(MOD_LSFT|MOD_RSFT)>;
                };
        };

keymap {
        compatible = "zmk,keymap";

default_layer {
        bindings = <
  &none &kp TAB      &kp Q      &kp W      &kp F        &kp P        &kp B              /**/  &kp J &kp L &kp U       &kp Y     &kp SEMICOLON  &kp DEL       &none
        &hm LGUI ESC &kp A      &kp R      &kp S        &kp T        &kp G              /**/  &kp M &kp N &kp E       &kp I     &kp O          &kp BSPC
        &kp LCTRL    &hm LALT Z &kp X      &kp C        &kp D        &kp V              /**/  &kp K &kp H &kp COMMA   &kp DOT   &hm RALT SLASH &hm RCTRL INSERT
                                           &lt FNL ESC  &mt LSHIFT SPACE   &lt LWR TAB  /**/  &lt LWR ENTER     &hm RSHIFT BSPC &lt FNL DEL
        >;
};
//TODO: add pgUp & pgDwn

        /*
     0  1  2  3  4  5  6     7  8  9  10 11 12   13
        14 15 16 17 18 19    20 21 22 23 24 25
        26 27 28 29 30 31    32 33 34 35 36 37
        */


lower_layer {
        bindings = <
  &none   &kp C_BRI_DEC &kp C_BRI_INC &shfm PG_UP HOME   &kp UP      &shfm PG_DN END    &kp C_VOL_UP    /**/    &kp KP_PLUS  &kp N7  &kp N8 &kp N9  &none   &none           &none
          &kp CAPS      &kp EQUAL     &kp LEFT           &kp DOWN    &kp RIGHT          &kp C_VOL_DN    /**/    &kp KP_DOT   &kp N4  &kp N5 &kp N6  &kp N0  &kp BSPC
          &trans        &trans        &kp C_PREV         &kp C_PP    &kp C_NEXT         &kp C_MUTE      /**/    &kp KP_MINUS &kp N1  &kp N2 &kp N3  &trans  &trans
                                                         &lt ADJ ESC &trans             &trans          /**/    &trans       &trans     &lt ADJ DEL
        >;
};




fn_layer {
        bindings = <
  &none   &none    &none   &none   &none   &none   &none          &none   &none   &none   &none   &none   &none           &none
          &none    &kp F1  &kp F2  &kp F3  &kp F4  &kp F5         &kp F6  &kp F7  &kp F8 &kp F9  &kp F10 &none 
          &none    &kp F11 &kp F12 &kp F13 &kp F14 &kp F15        &kp F16 &kp F17 &kp F1 &kp F19 &kp F20 &kp F21
                        &trans      &trans      &lt ADJ TAB       &lt ADJ ENTER    &trans     &trans
        >;
};



adjust_layer {
        bindings = <
  &none   &bootloader   &none          &none          &none          &none          &none               &none          &none          &none          &none          &none          &bootloader   &none
          &bt BT_CLR    &bt BT_SEL 0   &bt BT_SEL 1   &bt BT_SEL 2   &bt BT_SEL 3   &bt BT_SEL 4        &bt BT_SEL 4   &bt BT_SEL 3   &bt BT_SEL 2   &bt BT_SEL 1   &bt BT_SEL 0   &bt BT_CLR
          &bootloader   &none          &none          &none          &none          &none               &none          &none          &none          &none          &none          &bootloader
                                                      &trans         &none          &trans              &none          &trans         &trans
        >;
};

};
};



/ {
    combos {
            compatible = "zmk,combos";
            /*left hand*/
            // row 1
            combo_lbkt{
                timeout-ms = <50>; \
                bindings = <&kp LBKT>;\
                key-positions = <3 4>;\
                layers = <0>;\
            };     // [
            combo_rbkt{
                timeout-ms = <50>; \
                bindings = <&kp RBKT>;\
                key-positions = <4 5>;\
                layers = <0>;\
            };     // ]
            //row 1.5
            combo_at{
                timeout-ms = <50>; \
                bindings = <&kp AT>;\
                key-positions = <3 16>;\
                layers = <0>;\
            };     // @
            combo_hash{
                timeout-ms = <50>; \
                bindings = <&kp HASH>;\
                key-positions = <4 17>;\
                layers = <0>;\
            };     // #
            combo_excl{
                timeout-ms = <50>; \
                bindings = <&kp EXCL>;\
                key-positions = <4 18>;\
                layers = <0>;\
            };     // !
            combo_dollar{
                timeout-ms = <50>; \
                bindings = <&kp DOLLAR>;\
                key-positions = <5 18>;\
                layers = <0>;\
            };     // $
            combo_percent{
                timeout-ms = <50>; \
                bindings = <&kp PERCENT>;\
                key-positions = <6 19>;\
                layers = <0>;\
            };     // %
            //row 2
            combo_minus{
                timeout-ms = <50>; \
                bindings = <&kp MINUS>;\
                key-positions = <16 17>;\
                layers = <0>;\
            };     // -
            combo_equal{
                timeout-ms = <50>; \
                bindings = <&kp EQUAL>;\
                key-positions = <17 18>;\
                layers = <0>;\
            };     // =
            combo_plus{
                timeout-ms = <50>; \
                bindings = <&kp PLUS>;\
                key-positions = <18 19>;\
                layers = <0>;\
            };     // +
            //row 2.5
            combo_accent{
                timeout-ms = <50>; \
                bindings = <&kp GRAVE>;\
                key-positions = <17 29>;\
                layers = <0>;\
            };     // `
            combo_under{
                timeout-ms = <50>; \
                bindings = <&kp UNDER>;\
                key-positions = <17 30>;\
                layers = <0>;\
            };     // _
            combo_tilde{
                timeout-ms = <50>; \
                bindings = <&kp TILDE>;\
                key-positions = <18 30>;\
                layers = <0>;\
            };     // ~
            //row 3
            combo_lbrc{
                timeout-ms = <50>; \
                bindings = <&kp LEFT_BRACE>;\
                key-positions = <28 29>;\
                layers = <0>;\
            };     // {
            combo_rbrc{
                timeout-ms = <50>; \
                bindings = <&kp RIGHT_BRACE>;\
                key-positions = <29 30>;\
                layers = <0>;\
            };   // };

            /*right hand*/
            // row 1
            combo_lpar{
                timeout-ms = <50>; \
                bindings = <&kp LPAR>;\
                key-positions = <8 9>;\
                layers = <0>;\
            };     // (
            combo_rpar{
                timeout-ms = <50>; \
                bindings = <&kp RPAR>;\
                key-positions = <9 10>;\
                layers = <0>;\
            };     // )
            //row 1.5
            combo_caret{
                timeout-ms = <50>; \
                bindings = <&kp CARET>;\
                key-positions = <7 20>;\
                layers = <0>;\
            };     // ^
            combo_amps{
                timeout-ms = <50>; \
                bindings = <&kp AMPS>;\
                key-positions = <8 21>;\
                layers = <0>;\
            };     // &
            combo_star{
                timeout-ms = <50>; \
                bindings = <&kp STAR>;\
                key-positions = <9 22>;\
                layers = <0>;\
            };     // *
            combo_question{
                timeout-ms = <50>; \
                bindings = <&kp QUESTION>;\
                key-positions = <9 21>;\
                layers = <0>;\
            };     // ?
            combo_backslash{
                timeout-ms = <50>; \
                bindings = <&kp BACKSLASH>;\
                key-positions = <10 23>;\
                layers = <0>;\
            };     // \
            //row 2
            combo_pipe{
                timeout-ms = <50>; \
                bindings = <&kp PIPE>;\
                key-positions = <20 21>;\
                layers = <0>;\
            };     // |
            combo_double_quote{
                timeout-ms = <50>; \
                bindings = <&kp DOUBLE_QUOTES>;\
                key-positions = <21 22>;\
                layers = <0>;\
            };     // "
            combo_single_quote{
                timeout-ms = <50>; \
                bindings = <&kp SINGLE_QUOTE>;\
                key-positions = <22 23>;\
                layers = <0>;\
            };     // '
            //row 2.5
            combo_colon{
                timeout-ms = <50>; \
                bindings = <&kp COLON>;\
                key-positions = <22 33>;\
                layers = <0>;\
            };     // :
            //row 3
            combo_lt{
                timeout-ms = <50>; \
                bindings = <&kp LT>;\
                key-positions = <33 34>;\
                layers = <0>;\
            };     // <
            combo_gt{
                timeout-ms = <50>; \
                bindings = <&kp GT>;\
                key-positions = <34 35>;\
                layers = <0>;\
            };// >

        /*
     0  1  2  3  4  5  6     7  8  9  10 11 12   13
        14 15 16 17 18 19    20 21 22 23 24 25
        26 27 28 29 30 31    32 33 34 35 36 37
        */

            // COMBO(LTGT, &none ,33 35) // <><-
            combo_ltgt{
                timeout-ms = <50>; \
                bindings = <&kp LT &kp LEFT &kp GT>;\
                key-positions = <33 35>;\
                layers = <0>;\
            };//<><-
            // COMBO(BBKTS, &none ,3 5)   // []<-
            combo_bkts{
                timeout-ms = <50>; \
                bindings = <&kp LBKT &kp LEFT &kp RBKT>;\
                key-positions = <3 5>;\
                layers = <0>;\
            };//[]<-
            // COMBO(GRAVES, &none AT, 16 28) // ``<-
            combo_graves{
                timeout-ms = <50>; \
                bindings = <&kp GRAVE &kp LEFT &kp GRAVE>;\
                key-positions = <16 28>;\
                layers = <0>;\
            };//``<-
            // COMBO(BRACES, &none, 28 30) // {};<-
            combo_braces{
                timeout-ms = <50>; \
                bindings = <&kp LEFT_BRACE &kp LEFT &kp RIGHT_BRACE>;\
                key-positions = <28 30>;\
                layers = <0>;\
            };//{}<-
            // COMBO(BPARS, &none, 8 10)     // ()<-
            combo_pars{
                timeout-ms = <50>; \
                bindings = <&kp LPAR &kp LEFT &kp RPAR>;\
                key-positions = <8 10>;\
                layers = <0>;\
            };//()<-
            // COMBO(FULL_QUOTES, &none, 21 33) // ""<-
            combo_dquotes{
                timeout-ms = <50>; \
                bindings = <&kp DOUBLE_QUOTES &kp LEFT &kp DOUBLE_QUOTES>;\
                key-positions = <21 33>;\
                layers = <0>;\
            };//""<-
            // COMBO(SMALL_QUOTES, &none, 22 34) // ''<-
            combo_quotes{
                timeout-ms = <50>; \
                bindings = <&kp SINGLE_QUOTE &kp LEFT &kp SINGLE_QUOTE>;\
                key-positions = <22 34>;\
                layers = <0>;\
            };//""<-

            // COMBO(shiftins, &none ,16 18)  // shift+ins
            combo_shiftins{
                timeout-ms = <50>; \
                bindings = <&kp LSHIFT>,<&kp INS>;\
                key-positions = <16 18>;\
                layers = <0>;\
            };//


    };

    // macros {
    //     insert_bracket: insert_bracket {
    //         wait-ms = <40>;
    //         tap-ms = <40>;
    //         label = "INSERT_BRACKET";
    //         compatible = "zmk,behavior-macro";
    //         #binding-cells = <0>;
    //         bindings
    //             = <&macro_tap &kp &kp LEFT &kp>;
    //     };
    // };
};

